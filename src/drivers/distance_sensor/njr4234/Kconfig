## src/drivers/distance_sensor/njr4234/Kconfig
```kconfig
menuconfig DRIVERS_DISTANCE_SENSOR_NJR4234
	bool "njr4234"
	default n
	---help---
		Enable support for njr4234
```

## src/drivers/distance_sensor/sp25/Kconfig
```kconfig
menuconfig DRIVERS_DISTANCE_SENSOR_SP25
	bool "sp25"
	default n
	---help---
		Enable support for sp25
```
